#include "../keymap.dtsi"

&kscan {
    events = <
        PRESS_A RELEASE_A PRESS_S RELEASE_S PRESS_D RELEASE_D PRESS_F RELEASE_F PRESS_J RELEASE_J PRESS_K RELEASE_K PRESS_L RELEASE_L PRESS_SEMI RELEASE_SEMI
    >;
};
